## config/Kconfig
```kconfig
config CHARYBDIS_PMW3610_PERIPHERAL_KEYMAP_STUBS
    bool "PMW3610 keymap stubs for Charybdis split peripheral"
    default y if SHIELD_CHARYBDIS_RIGHT_PERIPHERAL
    depends on PMW3610 && ZMK_SPLIT && !ZMK_SPLIT_ROLE_CENTRAL

config SENYATYL_PMW3360_PERIPHERAL_KEYMAP_STUBS
    bool "PMW3360 keymap stubs for Senyatyl split peripheral"
    default y if SHIELD_SENYATYL_RIGHT_PERIPHERAL
    depends on PMW3360 && ZMK_SPLIT && !ZMK_SPLIT_ROLE_CENTRAL
```

## config/boards/shields/charybdis/Kconfig.shield
```kconfig
config SHIELD_CHARYBDIS_LEFT
    def_bool $(shields_list_contains,charybdis_left)

config SHIELD_CHARYBDIS_RIGHT
    def_bool $(shields_list_contains,charybdis_right)

config SHIELD_CHARYBDIS_RIGHT_PERIPHERAL
    def_bool $(shields_list_contains,charybdis_right_peripheral)

config SHIELD_CHARYBDIS_DONGLE
    def_bool $(shields_list_contains,charybdis_dongle)
```

## config/boards/shields/senyatyl/Kconfig.defconfig
```kconfig
if SHIELD_SENYATYL_RIGHT || SHIELD_SENYATYL_RIGHT_NOMOUSE || SHIELD_SENYATYL_RIGHT_COL2ROW

config ZMK_KEYBOARD_NAME
    default "Senyatyl"

config ZMK_SPLIT_BLE_ROLE_CENTRAL
    default y

endif

if SHIELD_SENYATYL_LEFT || SHIELD_SENYATYL_RIGHT || SHIELD_SENYATYL_RIGHT_NOMOUSE || SHIELD_SENYATYL_RIGHT_COL2ROW || SHIELD_SENYATYL_RIGHT_PERIPHERAL

config ZMK_SPLIT
    default y

endif
```

## config/boards/shields/senyatyl/Kconfig.shield
```kconfig
config SHIELD_SENYATYL_LEFT
    def_bool $(shields_list_contains,senyatyl_left)

config SHIELD_SENYATYL_RIGHT
    def_bool $(shields_list_contains,senyatyl_right)

config SHIELD_SENYATYL_RIGHT_NOMOUSE
    def_bool $(shields_list_contains,senyatyl_right_nomouse)

config SHIELD_SENYATYL_RIGHT_COL2ROW
    def_bool $(shields_list_contains,senyatyl_right_col2row)

config SHIELD_SENYATYL_RIGHT_PERIPHERAL
    def_bool $(shields_list_contains,senyatyl_right_peripheral)
```

## config/west.yml
```yaml
manifest:
  remotes:
    - name: zmkfirmware
      url-base: https://github.com/zmkfirmware
    - name: badjeff
      url-base: https://github.com/badjeff
  projects:
    - name: zmk
      remote: zmkfirmware
      revision: v0.3
      import: app/west.yml
    - name: zmk-pmw3610-driver
      remote: badjeff
      revision: zmk-0.3
      
  self:
    path: config
```
