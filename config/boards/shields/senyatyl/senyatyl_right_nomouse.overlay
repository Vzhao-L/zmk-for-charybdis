#include "senyatyl.dtsi"

&default_transform {
    col-offset = <6>;
};

&kscan0 {
    col-gpios
        = <&gpio1 4  (GPIO_ACTIVE_HIGH | GPIO_PULL_DOWN)> /* D8 */
        , <&gpio1 6  (GPIO_ACTIVE_HIGH | GPIO_PULL_DOWN)> /* D9 */
        , <&gpio0 9  (GPIO_ACTIVE_HIGH | GPIO_PULL_DOWN)> /* D10 */
        , <&gpio0 10 (GPIO_ACTIVE_HIGH | GPIO_PULL_DOWN)> /* D16 */
        , <&gpio1 11 (GPIO_ACTIVE_HIGH | GPIO_PULL_DOWN)> /* D14 */
        , <&gpio1 13 (GPIO_ACTIVE_HIGH | GPIO_PULL_DOWN)> /* D15 */
        ;

    row-gpios
        = <&gpio0 31 GPIO_ACTIVE_HIGH> /* D21 */
        , <&gpio0 29 GPIO_ACTIVE_HIGH> /* D20 */
        , <&gpio0 2  GPIO_ACTIVE_HIGH> /* D19 */
        , <&gpio1 15 GPIO_ACTIVE_HIGH> /* D18 */
        ;
};

&gpio0 {
    pmw3360_reset_hog: pmw3360_reset_hog {
        gpio-hog;
        gpios = <11 GPIO_ACTIVE_HIGH>; /* D7 */
        output-high;
    };
};
